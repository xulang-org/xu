## examples/esp32/idf_cyd/main/Kconfig.projbuild
```kconfig
menu "Xu IDF CYD provisioning"

config XU_WIFI_SSID
    string "Wi-Fi SSID"
    default ""
    help
        WPA2-PSK 2.4 GHz test SSID. Keep private; do not commit real values.

config XU_WIFI_PASSWORD
    string "Wi-Fi password"
    default ""
    help
        WPA2-PSK password. Keep private; do not commit real values.

config XU_MQTT_URI
    string "MQTT broker URI"
    default "mqtt://192.168.1.10:1883"
    help
        LAN mqtt://IPv4:1883 URI for the anonymous test broker.

config XU_MQTT_ROOT
    string "MQTT topic root"
    default "xu/esp32/cyd"

config XU_HID_NAME
    string "BLE HID device name"
    default "XU-IDF-HID"

endmenu
```
